## nemu/src/memory/Kconfig
```kconfig
menu "Memory Configuration"

config MBASE
  hex "Memory base address"
  default 0x0        if ISA_x86
  default 0x80000000

config MSIZE
  hex "Memory size"
  default 0x8000000

config PC_RESET_OFFSET
  hex "Offset of reset vector from the base of memory"
  default 0x100000 if ISA_x86
  default 0

choice
  prompt "Physical memory definition"
  default PMEM_GARRAY
config PMEM_MALLOC
  bool "Using malloc()"
config PMEM_GARRAY
  depends on !TARGET_AM
  bool "Using global array"
endchoice

config MEM_RANDOM
  depends on MODE_SYSTEM && !DIFFTEST && !TARGET_AM
  bool "Initialize the memory with random values"
  default y
  help
    This may help to find undefined behaviors.

menuconfig HAS_MROM
  bool "Enable MROM"
  default y

if HAS_MROM
config MROMBASE
  hex "MROM base address"
  default 0x20000000
config MROMSIZE
  hex "MROM size"
  default 0x1000
endif # HAS_MROM

menuconfig HAS_SRAM
  bool "Enable SRAM"
  default y

if HAS_SRAM
config SRAMBASE
  hex "SRAM base address"
  default 0x0f000000
config SRAMSIZE
  hex "SRAM size"
  default 0x01000000
endif # HAS_SRAM

menuconfig HAS_FLASH
  bool "Enable FLASH"
  default y

if HAS_FLASH
config FLASHBASE
  hex "FLASH base address"
  default 0x30000000
config FLASHSIZE
  hex "FLASH size"
  default 0x10000000
endif # HAS_FLASH

endmenu #MEMORY
```

## npc/Kconfig
```kconfig
mainmenu "NPC Configuration Menu"

menu "ISA-dependent Options for riscv"

config RVE
  bool "Use E extension"
  default n
endmenu

choice
	prompt "Running mode"
	default BATCH_MODE
config BATCH_MODE
	bool "Running with batch mode"
config SDB_MODE
	bool "Running with sdb mode"
endchoice

menu "Verilator"
config WAVE_TRACE
	bool "Enable Wave tracer"
	default y
config WAVE_EREA_BEGIN
  hex "The begining of wave area"
  default 0x0
config WAVE_EREA_END
  hex "The end of wave area"
  default 0xffffffff
endmenu

config PERFORMANCE_COUNTER_ENABLE
  bool "Performance Counter Enable"
  default y

menu "Testing and Debugging"


config TRACE
  bool "Enable tracer"
  default y

config NO_TRACE_START_ADDR
  depends on TRACE
  hex "The begining address of trace"
  default 0
config NO_TRACE_END_ADDR
  depends on TRACE
  hex "The ending address of trace"
  default 0xffffffff

config TRACE_START
  depends on TRACE
  int "When tracing is enabled (unit: number of instructions)"
  default 0

config TRACE_END
  depends on TRACE
  int "When tracing is disabled (unit: number of instructions)"
  default 10000

config ITRACE
  depends on TRACE
  bool "Enable instruction tracer"
  default y

config ITRACE_COND
  depends on ITRACE
  string "Only trace instructions when the condition is true"
  default "true"

config MTRACE
  depends on TRACE
  bool "Enable memorary tracer"
  default n

config FTRACE
  depends on TRACE
  bool "Enable function tracer"
  default y


config DIFFTEST
  bool "Enable differential testing"
  default n
  help
    Enable differential testing with a reference design.
    Note that this will significantly reduce the performance of NEMU.
endmenu

menu "Memory Configuration"

config MBASE
  hex "Memory base address"
  default 0x0
  default 0x80000000

config MSIZE
  hex "Memory size"
  default 0x8000000

config PC_RESET_OFFSET
  hex "Offset of reset vector from the base of memory"
  default 0x100000 if ISA_x86
  default 0

menuconfig HAS_SRAM
  bool "Enable SRAM"
  default y

if HAS_SRAM
config SRAMMBASE
  hex "SRAM base address"
  default 0x0f000000
config SRAMSIZE
  hex "SRAM size"
  default 0x2000
endif # HAS_SRAM

menuconfig HAS_MROM
  bool "Enable MROM"
  default y

if HAS_MROM
config MROMBASE
  hex "MROM base address"
  default 0x20000000
config MROMSIZE
  hex "MROM size"
  default 0x1000
endif # HAS_MROM

menuconfig HAS_FLASH
  bool "Enable FLASH"
  default y

if HAS_FLASH
config FLASHCTRLBASE
  hex "FLASH base address"
  default 0x10001000
config FLASHBASE
  hex "FLASH base address"
  default 0x30000000
config FLASHSIZE
  hex "FLASH size"
  default 0x10000000
endif # HAS_FLASH

menuconfig HAS_PSRAM
  bool "Enable PSRAM"
  default y

if HAS_PSRAM
config PSRAMBASE
  hex "PSRAM base address"
  default 0x80000000
config PSRAMSIZE
  hex "PSRAM size"
  default 0x20000000
endif # HAS_PSRAM

endmenu

menu "Build Options"

choice
  prompt "Optimization Level"
  default CC_O2
config CC_O0
  bool "O0"
config CC_O1
  bool "O1"
config CC_O2
  bool "O2"
config CC_O3
  bool "O3"
config CC_OS
  bool "Os"
endchoice

config CC_OPT
  string
  default "-O0" if CC_O0
  default "-O1" if CC_O1
  default "-O2" if CC_O2
  default "-O3" if CC_O3
  default "-Os" if CC_OS
  default "none"

config CC_DEBUG
  bool "Enable debug information"
  default n

config CC_ASAN
  bool "Enable address sanitizer"
  default n
endmenu

menu "SoC"
config SOC
  bool "Enable SoC"
  default n
config NVBOARD
  depends on SOC
  bool "Enable nvboard"
  default n
menu "SoC Device"
depends on SOC
menu "UART16550"
config UART16550_BASE
	hex "UART16550 base address"
	default 0x10000000
config UART16550_RBR_THR_DLL
	hex "RBR THR DLL"
	default 0x0
config UART16550_IER_DLM
	hex "IER DLM"
	default 0x1
config UART16550_IIR_FCR
	hex "IIR FCR"
	default 0x2
config UART16550_LCR
	hex "LCR"
	default 0x3
config UART16550_MCR
	hex "MCR"
	default 0x4
config UART16550_LSR
	hex "LSR"
	default 0x5
config UART16550_MSR
	hex "MSR"
	default 0x6
endmenu

endmenu

endmenu
```
